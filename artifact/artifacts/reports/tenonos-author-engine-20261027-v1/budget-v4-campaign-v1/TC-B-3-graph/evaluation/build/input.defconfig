## artifact/artifacts/reports/tenonos-author-engine-20261027-v1/budget-v4-campaign-v1/TC-B-3-graph/evaluation/build/input.defconfig
```kconfig
CONFIG_ARCH_ARM_64=y
CONFIG_MCPU_ARM64_CORTEX_A72=y
CONFIG_ARM64_ERRATUM_858921=n
CONFIG_ARM64_ERRATUM_835769=n
CONFIG_ARM64_ERRATUM_843419=n
CONFIG_PLAT_KVM=y
CONFIG_FPSIMD=y
CONFIG_VIRTUALIZE_PLAT_MEM_SIZE=0x8000000
CONFIG_LIBUKLOCK=y
CONFIG_LIBUKLOCK_MUTEX=n
CONFIG_LIBUKLOCK_RWLOCK=n
CONFIG_LIBTNSYSTICK_FREQ=1000
CONFIG_LIBUKDEBUG_ENABLE_ASSERT=y
CONFIG_LIBUKBOOT_INITSCHEDPRIO=y
```

## artifact/artifacts/reports/tenonos-resource-history-campaign-v1/H2-direct/R2/evaluation/build/input.defconfig
```kconfig
CONFIG_ARCH_ARM_64=y
CONFIG_ARM64_ERRATUM_835769=n
CONFIG_ARM64_ERRATUM_843419=n
CONFIG_ARM64_ERRATUM_858921=n
CONFIG_FPSIMD=y
CONFIG_LIBTNSCHEDPRIO_ENABLE_PREEMTIVE=y
CONFIG_LIBTNSYSTICK_FREQ=1000
CONFIG_LIBUKBOOT_INITSCHEDPRIO=y
CONFIG_LIBUKDEBUG_ENABLE_ASSERT=y
CONFIG_LIBUKLOCK=y
CONFIG_LIBUKLOCK_MUTEX=n
CONFIG_LIBUKLOCK_RWLOCK=n
CONFIG_MCPU_ARM64_CORTEX_A72=y
CONFIG_PLAT_KVM=y
CONFIG_VIRTUALIZE_PLAT_MEM_SIZE=0x8000000
CONFIG_LIBUKBOOT_INITBBUDDY=n
CONFIG_LIBUKBOOT_INITREGION=n
CONFIG_LIBUKBOOT_INITTLSF=y
CONFIG_LIBUKBOOT_NOALLOC=n
CONFIG_TLSF_LOG2_SLI=5
```

## artifact/artifacts/reports/tenonos-rpi4-v1/references/composition/build/input.defconfig
```kconfig
CONFIG_ARCH_ARM_64=y
CONFIG_MCPU_ARM64_CORTEX_A72=y
# CONFIG_ARM64_ERRATUM_858921 is not set
# CONFIG_ARM64_ERRATUM_835769 is not set
# CONFIG_ARM64_ERRATUM_843419 is not set
CONFIG_PLAT_KVM=y
CONFIG_FPSIMD=y
CONFIG_VIRTUALIZE_PLAT_MEM_SIZE=0x8000000
CONFIG_LIBUKLOCK=y
# CONFIG_LIBUKLOCK_MUTEX is not set
# CONFIG_LIBUKLOCK_RWLOCK is not set
CONFIG_LIBTNSYSTICK_FREQ=1000
CONFIG_LIBUKBOOT_INITSCHEDPRIO=y
CONFIG_LIBTNSCHEDPRIO_ENABLE_PREEMTIVE=y
CONFIG_LIBUKBOOT_INITTLSF=y
CONFIG_TLSF_LOG2_SLI=2
```
